/*###ICF### Section handled by ICF editor, don't touch! ****/
/*-Editor annotation file-*/
/* IcfEditorFile="$TOOLKIT_DIR$\config\ide\IcfEditor\a_v1_0.xml" */
/*-Specials-*/
define symbol __ICFEDIT_intvec_start__ = 0x08000000;
define symbol __ICFEDIT_Init_Table__ = 0x0800C800 ;

define symbol __ICFEDIT_User_intvec_start__ = 0x0800D000 ;
define symbol __ICFEDIT_User_info__ = 0x0803FE00 ;
define symbol __ICFEDIT_Init_Table1__ = 0x0803F000 ;


/*-Memory Regions-*/
define symbol __ICFEDIT_region_INIT_start__     = 0x08000200 ;
define symbol __ICFEDIT_region_INIT_end__ 	= 0x08000FFF ;
define symbol __ICFEDIT_region_BOOT_start__     = 0x08001000 ;
define symbol __ICFEDIT_region_BOOT_end__ 	= 0x0800C7FF ;

define symbol __ICFEDIT_region_ROM_start__	= 0x0800D000 ;
define symbol __ICFEDIT_region_ROM_end__   	= 0x0803DFFF ;

define symbol __ICFEDIT_region_INITRAM_start__ 	= 0x20000000 ;
define symbol __ICFEDIT_region_INITRAM_end__   	= 0x200001FF ;

define symbol __ICFEDIT_region_BOOTRAM_start__ 	= 0x20000200 ;
define symbol __ICFEDIT_region_BOOTRAM_end__   	= 0x2000BFFF ;

define symbol __ICFEDIT_region_VECTRAM_start__ 	= 0x2000C000 ;
define symbol __ICFEDIT_region_VECTRAM_end__   	= 0x2000C1FF ;

define symbol __ICFEDIT_region_RAM_start__ 	= 0x2000C200 ;
define symbol __ICFEDIT_region_RAM_end__   	= 0x2000FFFF ;
/*-Sizes-*/
define symbol __ICFEDIT_size_cstack__ = 0x3000 ;
define symbol __ICFEDIT_size_heap__   = 0x3000 ;
/**** End of ICF editor section. ###ICF###*/


define memory mem with size = 4G;
define region INIT_region  = mem:[from __ICFEDIT_region_INIT_start__   to __ICFEDIT_region_INIT_end__];
define region INITRAM_region = mem:[from __ICFEDIT_region_INITRAM_start__   to __ICFEDIT_region_INITRAM_end__];
define region BOOT_region  = mem:[from __ICFEDIT_region_BOOT_start__   to __ICFEDIT_region_BOOT_end__];
define region BOOTRAM_region = mem:[from __ICFEDIT_region_BOOTRAM_start__   to __ICFEDIT_region_BOOTRAM_end__];
define region ROM_region   = mem:[from __ICFEDIT_region_ROM_start__   to __ICFEDIT_region_ROM_end__];
define region RAM_region   = mem:[from __ICFEDIT_region_RAM_start__   to __ICFEDIT_region_RAM_end__];

define block CSTACK    with alignment = 8, size = __ICFEDIT_size_cstack__   { };
define block HEAP      with alignment = 8, size = __ICFEDIT_size_heap__     { };



//initialize manually { readwrite  };
initialize by copy with packing = none { readwrite };
do not initialize  { section .noinit };

place at address mem:__ICFEDIT_intvec_start__ { readonly section .intvec };
place at address mem:__ICFEDIT_User_info__	  { readonly section .userinfo };
place at address mem:__ICFEDIT_User_intvec_start__ { readonly section .intvec1 };
place at address mem:__ICFEDIT_Init_Table__ { readonly section .iar.init_table };


//
place in BOOTRAM_region { block CSTACK, block HEAP };
place in RAM_region   { readwrite } ;
place in ROM_region   { readonly };

                        
                        
/* Place startup code at a fixed address */
place at start of BOOT_region { readonly section .cstartup  };
//place at start of BOOT_region { readonly section .iar.init_table };





/* Place Boot object to sepcial address */
place in BOOT_region { section .text object boot.o,section .rodata object boot.o  
                      ,section .text object Boot_startup_stm32f10x_cl.o,section .rodata object Boot_startup_stm32f10x_cl.o
                      ,section .text object boot_it.o,section .rodata object boot_it.o
                      ,section .text object scsi.o,section .rodata object scsi.o,section .data_init object scsi.o
                      ,section .text object usb_mst.o,section .rodata object usb_mst.o,section .data_init object usb_mst.o
                      ,section .text object usb_host.o,section .rodata object usb_host.o,section .data_init object usb_host.o
                      ,section .text object usb_utils.o,section .rodata object usb_utils.o,section .data_init object usb_utils.o
                      ,section .text object stm32uh_hw.o,section .rodata object stm32uh_hw.o,section .data_init object stm32uh_hw.o
                      ,section .text object stm32uh_hub.o,section .rodata object stm32uh_hub.o,section .data_init object stm32uh_hub.o
                      ,section .text object stm32uh.o,section .rodata object stm32uh.o ,section .data_init object stm32uh.o
                      ,section .text object pmgr.o,section .rodata object pmgr.o,section .data_init object pmgr.o
                      //,section .text object system_stm32f10x.o,section .rodata object system_stm32f10x.o 
                      //,section .text object core_cm3.o,section .rodata object core_cm3.o,section .data_init object core_cm3.o
                      ,section .text object common.o,section .rodata object common.o,section .data_init object common.o
                      ,section .text object fat_m.o,section .rodata object fat_m.o,section .data_init object fat_m.o
                      ,section .text object fat_lfn.o,section .rodata object fat_lfn.o,section .data_init object fat_lfn.o
                      ,section .text object fat.o,section .rodata object fat.o,section .data_init object fat.o
                      ,section .text object port_f.o,section .rodata object port_f.o,section .data_init object port_f.o
                      ,section .text object mst.o,section .rodata object mst.o,section .data_init object mst.o
                      ,section .text object os_nrtos.o,section .rodata object os_nrtos.o,section .data_init object os_nrtos.o
                      //,section .text object misc.o,section .rodata object misc.o,section .data_init object misc.o
                      ,section .text object Bootflash.o,section .rodata object Bootflash.o
                      //,section .text object HT1381.o,section .rodata object HT1381.o
                      ,section .text object Stm32GPIO.o,section .rodata object Stm32GPIO.o
                      ,section .text object BootLCM.o,section .rodata object BootLCM.o

                      //Library
                      //,section .text object ABImemcpy.o,section .rodata object ABImemcpy.o
                      //,section .text object ABImemset.o,section .rodata object ABImemset.o
                      //,section .text object ABImemset48.o,section .rodata object ABImemset48.o
                      //,section .text object copy_init2.o,section .rodata object copy_init2.o
                      //,section .text object data_init2.o,section .rodata object data_init2.o
                      //,section .text object iarwstd.o,section .rodata object iarwstd.o
                      //,section .text object zero_init2.o,section .rodata object zero_init2.o
                      //,section .text object cmain.o,section .rodata object cmain.o
                      //,section .text object exit.o,section .rodata object exit.o
                      //,section .text object cexit.o,section .rodata object cexit.o
                      //,section .text object low_level_init.o,section .rodata object low_level_init.o
                      //,section .text object strcpy.o,section .rodata object strcpy.o
                      //,section .text object strncpy.o,section .rodata object strncpy.o
                      //,section .text object strlen.o,section .rodata object strlen.o
                      //,section .text object strstr.o,section .rodata object strstr.o
                      //,section .text object strchr.o,section .rodata object strchr.o
                      } ;

/* Place Boot object to sepcial address */
place in BOOTRAM_region {  section .bss object boot.o,section .data object boot.o  
                          ,section .bss object Boot_startup_stm32f10x_cl.o,section .data object Boot_startup_stm32f10x_cl.o
                          ,section .bss object boot_it.o,section .data object boot_it.o
                          ,section .bss object scsi.o,section .data object scsi.o
                          ,section .bss object usb_mst.o,section .data object usb_mst.o
                          ,section .bss object usb_host.o,section .data object usb_host.o
                          ,section .bss object usb_utils.o,section .data object usb_utils.o
                          ,section .bss object stm32uh_hw.o,section .data object stm32uh_hw.o
                          ,section .bss object stm32uh_hub.o,section .data object stm32uh_hub.o
                          ,section .bss object stm32uh.o,section .data object stm32uh.o 
                          ,section .bss object pmgr.o,section .data object pmgr.o
                          //,section .bss object system_stm32f10x.o,section .data object system_stm32f10x.o
                          //,section .bss object core_cm3.o,section .data object core_cm3.o
                          ,section .bss object common.o,section .data object common.o
                          ,section .bss object fat_m.o,section .data object fat_m.o
                          ,section .bss object fat_lfn.o,section .data object fat_lfn.o
                          ,section .bss object fat.o,section .data object fat.o
                          ,section .bss object port_f.o,section .data object port_f.o
                          ,section .bss object mst.o,section .data object mst.o
                          ,section .bss object os_nrtos.o,section .data object os_nrtos.o
                          //,section .bss object misc.o,section .data object misc.o
                          ,section .bss object Bootflash.o,section .data object Bootflash.o
                          //,section .bss object HT1381.o,section .data object HT1381.o
                          ,section .bss object Stm32GPIO.o,section .data object Stm32GPIO.o
                          ,section .bss object BootLCM.o,section .data object BootLCM.o
    
                          //Library
                          //,section .bss object ABImemcpy.o,section .data object ABImemcpy.o
                          //,section .bss object ABImemset.o,section .data object ABImemset.o
                          //,section .bss object ABImemset48.o,section .data object ABImemset48.o
                          //,section .bss object copy_init2.o,section .data object copy_init2.o
                          //,section .bss object data_init2.o,section .data object data_init2.o
                          //,section .bss object iarwstd.o,section .data object iarwstd.o
                          //,section .bss object zero_init2.o,section .data object zero_init2.o
                          //,section .bss object cmain.o,section .data object cmain.o
                          //,section .bss object exit.o,section .data object exit.o
                          //,section .bss object cexit.o,section .data object cexit.o
                          //,section .bss object low_level_init.o,section .data object low_level_init.o
                          //,section .bss object strcpy.o,section .data object strcpy.o
                          //,section .bss object strncpy.o,section .data object strncpy.o
                          //,section .bss object strlen.o,section .data object strlen.o
                          //,section .bss object strstr.o,section .data object strstr.o
                          //,section .bss object strchr.o,section .data object strchr.o
                      } ;      

place in INIT_region  {
                      //,section .text object core_cm3.o,section .rodata object core_cm3.o,section .data_init object core_cm3.o
                      ,section .text object system_stm32f10x.o,section .rodata object system_stm32f10x.o,section .data_init object system_stm32f10x.o
                      ,section .text object ABImemcpy.o,section .rodata object ABImemcpy.o
                      ,section .text object ABImemset.o,section .rodata object ABImemset.o
                      ,section .text object copy_init3.o,section .rodata object copy_init3.o
                      ,section .text object data_init.o,section .rodata object data_init.o
                      ,section .text object iarwstd.o,section .rodata object iarwstd.o
                      ,section .text object zero_init3.o,section .rodata object zero_init3.o
                      ,section .text object cmain.o,section .rodata object cmain.o
                      ,section .text object exit.o,section .rodata object exit.o
                      ,section .text object cexit.o,section .rodata object cexit.o
                      ,section .text object low_level_init.o,section .rodata object low_level_init.o
                      ,section .text object strcpy.o,section .rodata object strcpy.o
                      ,section .text object strncpy.o,section .rodata object strncpy.o
                      ,section .text object strlen.o,section .rodata object strlen.o
                      ,section .text object strstr.o,section .rodata object strstr.o
                      ,section .text object strchr.o,section .rodata object strchr.o
		      } ;
place in INITRAM_region {
                          ,section .bss object system_stm32f10x.o,section .data object system_stm32f10x.o
                          //,section .bss object core_cm3.o,section .data object core_cm3.o
			  ,section .bss object ABImemcpy.o,section .data object ABImemcpy.o
                          ,section .bss object ABImemset.o,section .data object ABImemset.o
                          ,section .bss object copy_init3.o,section .data object copy_init3.o
                          ,section .bss object data_init.o,section .data object data_init.o
                          ,section .bss object iarwstd.o,section .data object iarwstd.o
                          ,section .bss object zero_init3.o,section .data object zero_init3.o
                          ,section .bss object cmain.o,section .data object cmain.o
                          ,section .bss object exit.o,section .data object exit.o
                          ,section .bss object cexit.o,section .data object cexit.o
                          ,section .bss object low_level_init.o,section .data object low_level_init.o
                          ,section .bss object strcpy.o,section .data object strcpy.o
                          ,section .bss object strncpy.o,section .data object strncpy.o
                          ,section .bss object strlen.o,section .data object strlen.o
                          ,section .bss object strstr.o,section .data object strstr.o
                          ,section .bss object strchr.o,section .data object strchr.o
			} ;
					  
      